/* Copyright (c) 2015, Motorola Mobility Inc. All rights reserved.
 *
 * This program is free software; you can redistribute it and/or modify
 * it under the terms of the GNU General Public License version 2 and
 * only version 2 as published by the Free Software Foundation.
 */

/dts-v1/;

#include "msm8953-sanders.dtsi"

/ {
	model = "sanders";
	compatible = "qcom,msm8953-sanders", "qcom,msm8953-moto", "qcom,msm8953";
	qcom,msm-id = <293 0x0>;
	qcom,board-id = <0x4B 0x8400>, <0x4C 0x8400>;
};

