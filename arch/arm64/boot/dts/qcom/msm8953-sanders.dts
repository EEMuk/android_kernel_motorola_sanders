/* Copyright (c) 2015, Motorola Mobility Inc. All rights reserved.
 *
 * This program is free software; you can redistribute it and/or modify
 * it under the terms of the GNU General Public License version 2 and
 * only version 2 as published by the Free Software Foundation.
 *
 * This program is distributed in the hope that it will be useful,
 * but WITHOUT ANY WARRANTY; without even the implied warranty of
 * MERCHANTABILITY or FITNESS FOR A PARTICULAR PURPOSE.  See the
 * GNU General Public License for more details.
 */

/dts-v1/;

#include "msm8953-sanders.dtsi"

/*
 * One dtb for every sanders revision. The Motorola bootloader picks the
 * dtb from the QCDT table by msm-id + board-id, so this lists the ids of
 * all four 3.18 board files (msm8953-sanders-p1..p4.dts):
 *   P1 0x8100, P2 0x8200, P3 0x8300/0x83B0, P4 0x8400 (and 0x4C 0x8400).
 * No qcom,pmic-id, as in 3.18.
 */
/ {
	model = "sanders";
	compatible = "qcom,msm8953-sanders", "qcom,msm8953-moto",
			"qcom,msm8953";
	qcom,msm-id = <293 0x0>;
	qcom,board-id = <0x4B 0x8100>,
			<0x4B 0x8200>,
			<0x4B 0x8300>,
			<0x4B 0x83B0>,
			<0x4B 0x8400>,
			<0x4C 0x8400>;
};
